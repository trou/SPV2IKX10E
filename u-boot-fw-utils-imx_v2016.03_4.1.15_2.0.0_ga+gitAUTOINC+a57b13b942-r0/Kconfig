## u-boot-fw-utils-imx_v2016.03_4.1.15_2.0.0_ga+gitAUTOINC+a57b13b942-r0/Kconfig
```kconfig
if TARGET_MX6BSHSMBCPU

config SYS_BOARD
	default "mx6bshsmbcpu"

config SYS_VENDOR
	default "bsh"

config SYS_SOC
	default "mx6"
config SYS_CONFIG_NAME
	default "mx6bshsmbxxxcpu"

endif
```

## u-boot-fw-utils-imx_v2016.03_4.1.15_2.0.0_ga+gitAUTOINC+a57b13b942-r0/mx6bshsmbcpu_defconfig
```kconfig
CONFIG_ARM=y
CONFIG_ARCH_MX6=y
CONFIG_TARGET_MX6BSHSMBCPU=y
# CONFIG_SPL is not set
CONFIG_MX6ULL=y
CONFIG_MX6UL=y
CONFIG_DM_GPIO=y

CONFIG_SYS_PROMPT="bshsmb > "
CONFIG_CMD_MEMTEST=y
CONFIG_PINCTRL=y
CONFIG_PINCTRL_IMX6=y
CONFIG_DM_REGULATOR=y
CONFIG_OF_LIBFDT=y
#CONFIG_DM_I2C is not set
CONFIG_FIT=y
CONFIG_FIT_SIGNATURE=y
CONFIG_RSA=y


#CONFIG_AUTOBOOT_KEYED is not set
#CONFIG_AUTOBOOT_KEYED_CTRLC is not set
#CONFIG_AUTOBOOT_PROMPT is not set
#CONFIG_AUTOBOOT_DELAY_STR is not set
#CONFIG_AUTOBOOT_STOP_STR is not set
CONFIG_AUTOBOOT_KEYED=y
CONFIG_AUTOBOOT_PROMPT="Autobooting in %d seconds, press \"<Esc>\" to stop\n"
CONFIG_AUTOBOOT_STOP_STR="\x1b"

CONFIG_CMD_HW_VARIANT=y

CONFIG_SYS_EXTRA_OPTIONS="IMX_CONFIG=board/bsh/mx6bshsmbcpu/mx6bshsmbxxxcpu.cfg,MX6ULL,SYS_BOOT_NAND"
```

## u-boot-fw-utils-imx_v2016.03_4.1.15_2.0.0_ga+gitAUTOINC+a57b13b942-r0/mx6bshsmbcpu_mfg_defconfig
```kconfig
CONFIG_SYS_EXTRA_OPTIONS="IMX_CONFIG=board/bsh/mx6bshsmbcpu/mx6bshsmbxxxcpu.cfg,SYS_BOOT_NAND"
CONFIG_ARM=y
CONFIG_ARCH_MX6=y
CONFIG_TARGET_MX6BSHSMBCPU=y
CONFIG_MX6ULL=y
CONFIG_MX6UL=y
CONFIG_DM_GPIO=y
CONFIG_BOOTDELAY=3
CONFIG_SPL=y
CONFIG_HUSH_PARSER=y
CONFIG_SYS_PROMPT="bshsmb > "
# CONFIG_CMD_IMLS is not set
CONFIG_CMD_MEMTEST=y
# CONFIG_CMD_MMC is not set
CONFIG_CMD_I2C=y
CONFIG_CMD_GPIO=y
CONFIG_CMD_DHCP=y
CONFIG_CMD_PING=y
# CONFIG_OF_CONTROL is not set
# CONFIG_DEFAULT_DEVICE_TREE="imx6ull-bshsmb"
CONFIG_DM_I2C=y
CONFIG_DM_MMC=y
CONFIG_PINCTRL=y
CONFIG_PINCTRL_IMX6=y
CONFIG_DM_REGULATOR=y
# CONFIG_DM_SPI is not set
```
